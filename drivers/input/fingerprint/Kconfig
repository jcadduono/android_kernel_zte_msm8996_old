## drivers/input/fingerprint/Kconfig
```kconfig
#
# Fingerprint device configuration
#

source "drivers/input/fingerprint/synaptics_vfs/Kconfig"

source "drivers/input/fingerprint/goodix/Kconfig"
```

## drivers/input/touchscreen/ndt_stress/Kconfig
```kconfig
#
# NDT Force Touch driver configuration
#

config FORCE_TOUCH_NDT
	tristate "Force Touch by NDT"
	depends on I2C && INPUT
	help
	  This driver provides support for Force Touch by NDT.
```

## drivers/usb/typec/Kconfig
```kconfig
#
# USB Typec driver configuration
#

config USB_TYPEC
       bool "USB TYPEC"
       depends on I2C
       depends on USB
       ---help---
       Say Y here if you want to use USB TypeC.

config USB_HD3SS3220
       bool "USB HD3SS3220"
       depends on USB_TYPEC
       ---help---
       Say Y here if you want to use the TI HD3SS3220 chip.
```
